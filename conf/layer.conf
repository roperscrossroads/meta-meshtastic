## conf/layer.conf
```bitbake
BBPATH .= ":${LAYERDIR}"
BBFILES += "${LAYERDIR}/recipes-*/*/*.bb ${LAYERDIR}/recipes-*/*/*.bbappend"
BBFILE_COLLECTIONS += "meshtastic"
BBFILE_PATTERN_meshtastic = "^${LAYERDIR}/"
BBFILE_PRIORITY_meshtastic = "12"

LAYERDEPENDS_meshtastic = "core meta-python"
LAYERSERIES_COMPAT_meshtastic = "scarthgap styhead walnascar wrynose"
```
